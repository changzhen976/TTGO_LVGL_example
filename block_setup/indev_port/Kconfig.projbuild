## block_setup/indev_port/Kconfig.projbuild
```kconfig
menu "Example InDev Configuration"

    config EXAMPLE_ENCODER_ENABLE
        bool "if Enable Encoder"
        default y

endmenu
```

## block_setup/lvgl_setup/Kconfig.projbuild
```kconfig
menu "Example LilyGO Device Configuration"

    choice EXAMPLE_LILIGO_DEVICE_TYPE
        prompt "Which device you use"
    
        help
            Select LilyGO Device you use

        config EXAMPLE_LILIGO_T_DISPLAY
            bool "LilyGO T-display"
        
        config EXAMPLE_LILIGO_T_QT
            bool "lilyGO T-QT"
    endchoice

endmenu
```

## sdkconfig.defaults
```kconfig
CONFIG_PARTITION_TABLE_SINGLE_APP_LARGE=y
CONFIG_PARTITION_TABLE_FILENAME="partitions_singleapp_large.csv"
# CONFIG_LV_BUILD_EXAMPLES is not set
```
